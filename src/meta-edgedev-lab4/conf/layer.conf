## src/meta-edgedev-lab4/conf/layer.conf
```bitbake
# We have a conf and classes directory, add to BBPATH
BBPATH .= ":${LAYERDIR}"

# We have recipes-* directories, add to BBFILES
BBFILES += " ${LAYERDIR}/recipes-*/*/*.bb \
             ${LAYERDIR}/recipes-*/*/*.bbappend "

BBFILE_COLLECTIONS += "edgedev-lab4"
BBFILE_PATTERN_edgedev-lab4 = "^${LAYERDIR}/"
BBFILE_PRIORITY_edgedev-lab4 = "8"

# This should only be incremented on significant changes that will
# cause compatibility issues with other layers
LAYERVERSION_edgedev-lab4 = "1"
LAYERSERIES_COMPAT_edgedev-lab4 = "dunfell"

LAYERDEPENDS_edgedev-lab4 = "core"
```

## src/meta-edgedev-lab5/conf/layer.conf
```bitbake
# We have a conf and classes directory, add to BBPATH
BBPATH .= ":${LAYERDIR}"

# We have recipes-* directories, add to BBFILES
BBFILES += " ${LAYERDIR}/recipes-*/*/*.bb \
             ${LAYERDIR}/recipes-*/*/*.bbappend "

BBFILE_COLLECTIONS += "edgedev-lab5"
BBFILE_PATTERN_edgedev-lab5 = "^${LAYERDIR}/"
BBFILE_PRIORITY_edgedev-lab5 = "8"

# This should only be incremented on significant changes that will
# cause compatibility issues with other layers
LAYERVERSION_edgedev-lab5 = "1"
LAYERSERIES_COMPAT_edgedev-lab5 = "dunfell"

LAYERDEPENDS_edgedev-lab5 = "core"
```

## src/meta-edgedev-lab6/conf/layer.conf
```bitbake
# We have a conf and classes directory, add to BBPATH
BBPATH .= ":${LAYERDIR}"

# We have recipes-* directories, add to BBFILES
BBFILES += " ${LAYERDIR}/recipes-*/*/*.bb \
             ${LAYERDIR}/recipes-*/*/*.bbappend "

BBFILE_COLLECTIONS += "edgedev-lab6"
BBFILE_PATTERN_edgedev-lab6 = "^${LAYERDIR}/"
BBFILE_PRIORITY_edgedev-lab6 = "8"

# This should only be incremented on significant changes that will
# cause compatibility issues with other layers
LAYERVERSION_edgedev-lab6 = "1"
LAYERSERIES_COMPAT_edgedev-lab6 = "dunfell"

LAYERDEPENDS_edgedev-lab6 = "core"
```

## src/meta-edgedev-lab8/conf/layer.conf
```bitbake
# We have a conf and classes directory, add to BBPATH
BBPATH .= ":${LAYERDIR}"

# We have recipes-* directories, add to BBFILES
BBFILES += " ${LAYERDIR}/recipes-*/*/*.bb \
             ${LAYERDIR}/recipes-*/*/*.bbappend "

BBFILE_COLLECTIONS += "edgedev-lab8"
BBFILE_PATTERN_edgedev-lab8 = "^${LAYERDIR}/"
BBFILE_PRIORITY_edgedev-lab8 = "8"

# This should only be incremented on significant changes that will
# cause compatibility issues with other layers
LAYERVERSION_edgedev-lab8 = "1"
LAYERSERIES_COMPAT_edgedev-lab8 = "dunfell"

LAYERDEPENDS_edgedev-lab8 = "core"
```
